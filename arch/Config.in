## arch/Config.in
```kconfig
menu "Target options"

config BR2_ARCH_IS_64
	bool

choice
	prompt "Target Architecture"
	default BR2_x86_64
	help
	  Select the target architecture family to build for.

config BR2_arm
	bool "ARM"
	help
	  ARM is a 32-bit reduced instruction set computer (RISC)
	  instruction set architecture (ISA) developed by ARM Holdings.
	  Little endian.
	  http://www.arm.com/
	  http://en.wikipedia.org/wiki/ARM

config BR2_aarch64
	bool "AArch64"
	select BR2_ARCH_IS_64
	help
	  Aarch64 is a 64-bit architecture developed by ARM Holdings.
	  http://www.arm.com/products/processors/instruction-set-architectures/armv8-architecture.php
	  http://en.wikipedia.org/wiki/ARM

config BR2_x86_64
	bool "x86_64"
	select BR2_ARCH_IS_64
	help
	  x86-64 is an extension of the x86 instruction set (Intel i386
	  architecture compatible microprocessor).
	  http://en.wikipedia.org/wiki/X86_64

endchoice

# The following string values are defined by the individual
# Config.in.$ARCH files
config BR2_ARCH
	string

config BR2_NORMALIZED_ARCH
	string

if BR2_arm || BR2_aarch64
source "arch/Config.in.arm"
endif

if BR2_x86_64
source "arch/Config.in.x86"
endif

endmenu # Target options
```

## fs/Config.in
```kconfig
menu "Filesystem images"

source "fs/ext2/Config.in"
source "fs/initramfs/Config.in"
source "fs/iso9660/Config.in"
source "fs/romfs/Config.in"
source "fs/squashfs/Config.in"
source "fs/tar/Config.in"

endmenu
```

## package/Config.in
```kconfig
menu "Target packages"

	source "package/skeleton/Config.in"
	source "package/skeleton-custom/Config.in"
	source "package/skeleton-init-common/Config.in"
	source "package/skeleton-init-none/Config.in"
	source "package/skeleton-init-systemd/Config.in"

endmenu
```

## package/skeleton-ubuntu-base/Config.in
```kconfig
config BR2_PACKAGE_SKELETON_UBUNTU_BASE
	bool
	select BR2_PACKAGE_HAS_SKELETON
	select BR2_PACKAGE_SKELETON_INIT_COMMON

config BR2_PACKAGE_PROVIDES_SKELETON
	default "skeleton-ubuntu-base" if BR2_PACKAGE_SKELETON_UBUNTU_BASE
```
